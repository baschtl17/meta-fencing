## conf/bblayers.conf.sample
```bitbake
# POKY_BBLAYERS_CONF_VERSION is increased each time build/conf/bblayers.conf
# changes incompatibly
POKY_BBLAYERS_CONF_VERSION = "2"

BBPATH = "${TOPDIR}"
BBFILES ?= ""

BBLAYERS ?= " \
  ##OEROOT##/meta \
  ##OEROOT##/meta-poky \
  ##OEROOT##/meta-yocto-bsp \
  ##OEROOT##/meta-intel \
  ##OEROOT##/meta-raspberrypi \
  ##OEROOT##/meta-openembedded/meta-oe \
  ##OEROOT##/meta-openembedded/meta-webserver \
  ##OEROOT##/meta-openembedded/meta-gnome \
  ##OEROOT##/meta-oracle-java \
  ##OEROOT##/meta-browser \
  ##OEROOT##/meta-fencing \
  "
```

## conf/distro/include/fencing.conf
```bitbake
# generate tarballs from git repositories
BB_GENERATE_MIRROR_TARBALLS = "1"

# Generate btrfs and zipped rootfs
IMAGE_FSTYPES = "btrfs tar.xz"

# Use specific php version
PREFERRED_VERSION_php = "5.5.37"

# Use systemd
DISTRO_FEATURES_append = " systemd"
VIRTUAL-RUNTIME_init_manager = "systemd"
DISTRO_FEATURES_BACKFILL_CONSIDERED = "sysvinit"
VIRTUAL-RUNTIME_initscripts = ""

# install original GNU less as systemd pager because
# busybox less cannot handle colors
CORE_IMAGE_EXTRA_INSTALL += "btrfs-tools less"

# Accept oracle java and commercial licenses
LICENSE_FLAGS_WHITELIST += "oracle_java commercial"

# Enable locale generation at build time
ENABLE_BINARY_LOCALE_GENERATION = "1"

# disable package test builds
DISTRO_FEATURES_remove = " ptest"

# use FHS conform root directory
ROOT_HOME = "/root"

# On first boot, the ophardt database will be populated and
# fencing tournament data is updated. We need some extra
# space for that. 512MB should be more than enough
IMAGE_ROOTFS_EXTRA_SPACE = "524288"
```

## conf/layer.conf
```bitbake
# We have a conf and classes directory, add to BBPATH
BBPATH .= ":${LAYERDIR}"

# We have recipes-* directories, add to BBFILES
BBFILES += "${LAYERDIR}/recipes-*/*/*.bb \
            ${LAYERDIR}/recipes-*/*/*.bbappend"

# Additional license directories.
LICENSE_PATH += "${LAYERDIR}/custom-licenses"

BBFILE_COLLECTIONS += "meta-fencing"
BBFILE_PATTERN_meta-fencing = "^${LAYERDIR}/"
BBFILE_PRIORITY_meta-fencing = "100"
```

## scripts/lib/wic/canned-wks/usbstick.wks
```
# short-description: Create a bootable USB stick
# long-description: Creates a partitioned USB stick image that the user
# can directly dd to boot media.

part /boot --source bootimg-pcbios --ondisk sda --label boot --active --align 1024
part / --source rootfs --ondisk sda --size 1024 --fstype=btrfs --label platform --align 1024
part swap --ondisk sda --size 1024 --label swap1 --fstype=swap --align 1024
bootloader  --timeout=0  --append="rootwait rootfstype=btrfs"
```
